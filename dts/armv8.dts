/*
 * Copyright (c) 2015-2016, 2019 ARM Limited
 * All rights reserved
 *
 * Redistribution and use in source and binary forms, with or without
 * modification, are permitted provided that the following conditions are
 * met: redistributions of source code must retain the above copyright
 * notice, this list of conditions and the following disclaimer;
 * redistributions in binary form must reproduce the above copyright
 * notice, this list of conditions and the following disclaimer in the
 * documentation and/or other materials provided with the distribution;
 * neither the name of the copyright holders nor the names of its
 * contributors may be used to endorse or promote products derived from
 * this software without specific prior written permission.
 *
 * THIS SOFTWARE IS PROVIDED BY THE COPYRIGHT HOLDERS AND CONTRIBUTORS
 * "AS IS" AND ANY EXPRESS OR IMPLIED WARRANTIES, INCLUDING, BUT NOT
 * LIMITED TO, THE IMPLIED WARRANTIES OF MERCHANTABILITY AND FITNESS FOR
 * A PARTICULAR PURPOSE ARE DISCLAIMED. IN NO EVENT SHALL THE COPYRIGHT
 * OWNER OR CONTRIBUTORS BE LIABLE FOR ANY DIRECT, INDIRECT, INCIDENTAL,
 * SPECIAL, EXEMPLARY, OR CONSEQUENTIAL DAMAGES (INCLUDING, BUT NOT
 * LIMITED TO, PROCUREMENT OF SUBSTITUTE GOODS OR SERVICES; LOSS OF USE,
 * DATA, OR PROFITS; OR BUSINESS INTERRUPTION) HOWEVER CAUSED AND ON ANY
 * THEORY OF LIABILITY, WHETHER IN CONTRACT, STRICT LIABILITY, OR TORT
 * (INCLUDING NEGLIGENCE OR OTHERWISE) ARISING IN ANY WAY OUT OF THE USE
 * OF THIS SOFTWARE, EVEN IF ADVISED OF THE POSSIBILITY OF SUCH DAMAGE.
 */

/*
 * Last Modified 15th Mar. 2024 by Haoyuan Ma
 * Add support for multiple die with NUMA information
 */

/dts-v1/;

/memreserve/ 0x80000000 0x00010000;

/include/ CONF_PLATFORM


#define CPU(n, numa_id) \
	cpu@ ## n { \
		device_type = "cpu"; \
		compatible = "gem5,armv8", "arm,armv8"; \
		reg = < n >; \
		enable-method = "spin-table"; \
		cpu-release-addr = <0 0x87fffff8>; \
		numa-node-id = <numa_id>; \
	};

#if CONF_CPUS%CONF_DIES != 0
	#error CONF_CPUS must be multiple times of CONF_DIES
#endif

#define NUMA_NODE_ID(cpu_id) \
	(cpu_id / (CONF_CPUS/CONF_DIES))

/ {
	model = "V2P-AARCH64";
	compatible = "arm,vexpress,v2p-aarch64", "arm,vexpress";

	#if CONF_DIES == 1
	
	/* Memory Device for Single Die */
	memory@80000000 {
		device_type = "memory";
		reg = <0 0x80000000 0x4 0x00000000>;
		numa-node-id = <0>;
	};
	/* Distance Map for Single Die */
	distance-map {
		compatible = "numa-distance-map-v1";
		distance-matrix = <0 0 10>;
	};

	#elif CONF_DIES == 2
	/* Memory Device for Dual Dies */
	memory@80000000 {
		device_type = "memory";
		reg = <0 0x80000000 0 0x80000000>;
		numa-node-id = <0>;
	};

	memory@100000000 {
		device_type = "memory";
		reg = <0x1 0x00000000 0x1 0x00000000>;
		numa-node-id = <1>;
	};

	memory@200000000 {
		device_type = "memory";
		reg = <0x2 0x00000000 0x1 0x00000000>;
		numa-node-id = <0>;
	};

	memory@300000000 {
		device_type = "memory";
		reg = <0x3 0x00000000 0x1 0x00000000>;
		numa-node-id = <1>;
	};

	memory@400000000 {
		device_type = "memory";
		reg = <0x4 0x00000000 0 0x80000000>;
		numa-node-id = <0>;
	};

	/* Distance Map for Dual Dies */
	distance-map {
		compatible = "numa-distance-map-v1";
		distance-matrix = <0 0 10>, <0 1 20>, <1 1 10>;
	};
	#else
		#error Unsupported number of Dies
	#endif

	cpus {
		#address-cells = <1>;
		#size-cells = <0>;

		#if CONF_CPUS > 0
		CPU(0, NUMA_NODE_ID(0))
		#endif
		#if CONF_CPUS > 1
		CPU(1, NUMA_NODE_ID(1))
		#endif
		#if CONF_CPUS > 2
		CPU(2, NUMA_NODE_ID(2))
		#endif
		#if CONF_CPUS > 3
		CPU(3, NUMA_NODE_ID(3))
		#endif
		#if CONF_CPUS > 4
		CPU(4, NUMA_NODE_ID(4))
		#endif
		#if CONF_CPUS > 5
		CPU(5, NUMA_NODE_ID(5))
		#endif
		#if CONF_CPUS > 6
		CPU(6, NUMA_NODE_ID(6))
		#endif
		#if CONF_CPUS > 7
		CPU(7, NUMA_NODE_ID(7))
		#endif
		#if CONF_CPUS > 8
		CPU(8, NUMA_NODE_ID(8))
		#endif
		#if CONF_CPUS > 9
		CPU(9, NUMA_NODE_ID(9))
		#endif
		#if CONF_CPUS > 10
		CPU(10, NUMA_NODE_ID(10))
		#endif
		#if CONF_CPUS > 11
		CPU(11, NUMA_NODE_ID(11))
		#endif
		#if CONF_CPUS > 12
		CPU(12, NUMA_NODE_ID(12))
		#endif
		#if CONF_CPUS > 13
		CPU(13, NUMA_NODE_ID(13))
		#endif
		#if CONF_CPUS > 14
		CPU(14, NUMA_NODE_ID(14))
		#endif
		#if CONF_CPUS > 15
		CPU(15, NUMA_NODE_ID(15))
		#endif
		#if CONF_CPUS > 16
		#error Unsupported number of CPUs
		#endif
	};
};
